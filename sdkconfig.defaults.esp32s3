## sdkconfig.defaults.esp32s3
```kconfig
# ESP32-S3 目标默认配置 - 默认使用 ESP32-S3 通用开发板
CONFIG_BOARD_ESP32S3_GENERIC=y
CONFIG_ESPTOOLPY_FLASHSIZE_16MB=y
CONFIG_ESPTOOLPY_FLASHSIZE="16MB"
CONFIG_SPIRAM_MODE_OCT=y

# USB Audio Class 默认配置（当前 usb_device_uac 集成）。
# 两个流均保持立体声 48kHz，使 UAC 描述符、反馈
# 和 AirPlay USB 后端使用相同的重采样输出速率。
CONFIG_UAC_SPEAKER_CHANNEL_NUM=2
CONFIG_UAC_MIC_CHANNEL_NUM=2
CONFIG_UAC_SAMPLE_RATE=48000

# GPIO 默认配置
CONFIG_BAT_CHANNEL=7
CONFIG_LED_RGB_GPIO=47
CONFIG_LED_STATUS_GPIO=48

# 状态 LED 行为：仅播放时常亮，暂停/待机时熄灭（不闪烁）
CONFIG_LED_STATUS_PLAYING_STEADY=y
CONFIG_LED_STATUS_PAUSED_OFF=y
CONFIG_LED_STATUS_STANDBY_OFF=y
CONFIG_I2S_SCK_IO=8
CONFIG_I2S_BCK_IO=11
CONFIG_I2S_WS_IO=13
CONFIG_I2S_DO_IO=12
CONFIG_I2S_GND_IO=14

# 按钮配置（-1 表示禁用该按钮）
CONFIG_BTN_PLAY_PAUSE_GPIO=-1
CONFIG_BTN_VOLUME_UP_GPIO=-1
CONFIG_BTN_VOLUME_DOWN_GPIO=-1
CONFIG_BTN_NEXT_GPIO=-1
CONFIG_BTN_PREV_GPIO=-1

# ST7789 TFT 显示屏支持默认未启用。
# 显示屏为可选硬件 — 启用后会配置特定的 SPI GPIO 引脚，
# 可能与板上的其他外设冲突。
# 如需启用，请将以下配置添加到你的 sdkconfig.defaults.esp32s3
# 或运行：idf.py menuconfig -> Display Configuration
#
# CONFIG_DISPLAY_ENABLED=y
# CONFIG_DISPLAY_DRIVER_ST7789=y
# CONFIG_DISPLAY_BUS_SPI=y
# CONFIG_DISPLAY_SPI_CLK=18
# CONFIG_DISPLAY_SPI_MOSI=17
# CONFIG_DISPLAY_SPI_CS=15
# CONFIG_DISPLAY_SPI_DC=16
# CONFIG_DISPLAY_SPI_RST=21
# CONFIG_DISPLAY_BL_GPIO=38
# CONFIG_DISPLAY_UPDATE_MS=500
#
# LVGL 配置（启用显示屏时必需）：
# CONFIG_LV_CONF_SKIP=y
# CONFIG_LV_COLOR_DEPTH_16=y
# CONFIG_LV_MEM_SIZE_KILOBYTES=64
# CONFIG_LV_USE_LABEL=y
# CONFIG_LV_USE_BAR=y
# CONFIG_LV_USE_THEME_DEFAULT=y
# CONFIG_LV_FONT_MONTSERRAT_14=y
# CONFIG_LV_FONT_MONTSERRAT_16=y
# CONFIG_LV_FONT_MONTSERRAT_24=y
# CONFIG_LV_FONT_DEFAULT_MONTSERRAT_14=y
#
# 完整配置说明请参见 components/display/README.md。
```
